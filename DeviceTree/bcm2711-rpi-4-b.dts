&spi6 {
	status = "okay";
	pinctrl-names = "default";
	pinctrl-0 = <&spi6_gpio18>;
	cs-gpios = <&gpio 18 1>;

	ili9341@0 {
		compatible = "ilitek,ili9341";
		reg = <0>;
		
		spi-max-frequency = <20000000>;
		width = <320>;
		height = <240>;
		regwidth = <8>;
		rotate = <180>;
		fps = <30>;
		buswidth = <8>;
		reset-gpios = <&gpio 26 GPIO_ACTIVE_LOW>;
		dc-gpios = <&gpio 11 GPIO_ACTIVE_HIGH>;
		led-gpios = <&gpio 16 GPIO_ACTIVE_LOW>;
		status = "okay";
	};
};
